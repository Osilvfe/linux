## Documentation/devicetree/bindings/iio/imu/invensense,icm42607.yaml
```yaml
# SPDX-License-Identifier: (GPL-2.0-only OR BSD-2-Clause)
# Copyright (C) 2026 InvenSense, Inc.
# Copyright (c) 2026 Osilvfe <osilvfe@gmail.com>
%YAML 1.2
---
$id: http://devicetree.org/schemas/iio/imu/invensense,icm42607.yaml#
$schema: http://devicetree.org/meta-schemas/core.yaml#

title: InvenSense ICM-42607 inertial measurement unit

maintainers:
  - InvenSense, Inc. <linux-iio@vger.kernel.org>

properties:
  compatible:
    enum:
      - invensense,icm42607
      - invensense,icm42607p

  reg:
    maxItems: 1

  vdd-supply: true
  vddio-supply: true

  mount-matrix:
    description: Optional 3x3 mounting rotation matrix.

  spi-max-frequency: true

required:
  - compatible
  - reg
  - vdd-supply
  - vddio-supply

allOf:
  - $ref: /schemas/spi/spi-peripheral-props.yaml#

unevaluatedProperties: false
...
```

## Documentation/devicetree/bindings/input/oneplus,caihong-pogo.yaml
```yaml
# SPDX-License-Identifier: (GPL-2.0-only OR BSD-2-Clause)
# Copyright (c) 2026 Osilvfe <osilvfe@gmail.com>
%YAML 1.2
---
$id: http://devicetree.org/schemas/input/oneplus,caihong-pogo.yaml#
$schema: http://devicetree.org/meta-schemas/core.yaml#

title: OnePlus Caihong pogo keyboard and touchpad

maintainers:
  - Osilvfe <osilvfe@gmail.com>

properties:
  compatible:
    const: oneplus,caihong-pogo

  current-speed:
    description: UART baud rate used by the accessory protocol.

  power-gpios:
    maxItems: 1

  wake-gpios:
    maxItems: 1

  tx-enable-gpios:
    maxItems: 1

  touchpad-size-x:
    $ref: /schemas/types.yaml#/definitions/uint32

  touchpad-size-y:
    $ref: /schemas/types.yaml#/definitions/uint32

  touchpad-resolution-x:
    $ref: /schemas/types.yaml#/definitions/uint32

  touchpad-resolution-y:
    $ref: /schemas/types.yaml#/definitions/uint32

  oneplus,crc-ibm-init:
    $ref: /schemas/types.yaml#/definitions/uint32
    maximum: 65535
    description: Initial value for the accessory CRC-16/IBM calculation.

required:
  - compatible
  - current-speed

additionalProperties: false
...
```

## Documentation/devicetree/bindings/input/touchscreen/novatek,nt36532e.yaml
```yaml
# SPDX-License-Identifier: (GPL-2.0-only OR BSD-2-Clause)
# Copyright (c) 2026 Osilvfe <osilvfe@gmail.com>
%YAML 1.2
---
$id: http://devicetree.org/schemas/input/touchscreen/novatek,nt36532e.yaml#
$schema: http://devicetree.org/meta-schemas/core.yaml#

title: Novatek NT36532E no-flash touchscreen and pen controller

maintainers:
  - Osilvfe <osilvfe@gmail.com>

allOf:
  - $ref: touchscreen.yaml#
  - $ref: /schemas/spi/spi-peripheral-props.yaml#

properties:
  compatible:
    const: novatek,nt36532e

  reg:
    maxItems: 1

  interrupts:
    maxItems: 1

  reset-gpios:
    maxItems: 1

  panel: true

  firmware-name:
    maxItems: 1

  novatek,pen-support:
    type: boolean

  novatek,pen-max-pressure:
    $ref: /schemas/types.yaml#/definitions/uint32

  novatek,pen-max-tilt:
    $ref: /schemas/types.yaml#/definitions/uint32

required:
  - compatible
  - reg
  - interrupts
  - firmware-name

unevaluatedProperties: false
...
```

## Documentation/devicetree/bindings/media/i2c/giantec,gt9772.yaml
```yaml
# SPDX-License-Identifier: (GPL-2.0-only OR BSD-2-Clause)
# Copyright (c) 2026 Osilvfe <osilvfe@gmail.com>
%YAML 1.2
---
$id: http://devicetree.org/schemas/media/i2c/giantec,gt9772.yaml#
$schema: http://devicetree.org/meta-schemas/core.yaml#

title: Giantec GT9772 voice-coil lens actuator

maintainers:
  - Osilvfe <osilvfe@gmail.com>

properties:
  compatible:
    const: giantec,gt9772

  reg:
    maxItems: 1

  vio-supply: true
  vaf-supply: true

required:
  - compatible
  - reg
  - vio-supply
  - vaf-supply

additionalProperties: false
...
```

## Documentation/devicetree/bindings/media/i2c/smartsens,sc820cs.yaml
```yaml
# SPDX-License-Identifier: (GPL-2.0-only OR BSD-2-Clause)
# Copyright (c) 2026 Osilvfe <osilvfe@gmail.com>
%YAML 1.2
---
$id: http://devicetree.org/schemas/media/i2c/smartsens,sc820cs.yaml#
$schema: http://devicetree.org/meta-schemas/core.yaml#

title: SmartSens SC820CS CMOS image sensor

maintainers:
  - Osilvfe <osilvfe@gmail.com>

allOf:
  - $ref: /schemas/media/video-interface-devices.yaml#

properties:
  compatible:
    const: smartsens,sc820cs

  reg:
    maxItems: 1

  clocks:
    maxItems: 1

  clock-names:
    const: xvclk

  reset-gpios:
    maxItems: 1

  dovdd-supply: true
  avdd-supply: true
  dvdd-supply: true

  port:
    $ref: /schemas/graph.yaml#/$defs/port-base
    additionalProperties: false
    properties:
      endpoint:
        $ref: /schemas/media/video-interfaces.yaml#
        unevaluatedProperties: false

required:
  - compatible
  - reg
  - clocks
  - clock-names
  - dovdd-supply
  - avdd-supply
  - dvdd-supply
  - port

unevaluatedProperties: false
...
```

## Documentation/devicetree/bindings/power/supply/oneplus,caihong-battmgr.yaml
```yaml
# SPDX-License-Identifier: (GPL-2.0-only OR BSD-2-Clause)
%YAML 1.2
---
$id: http://devicetree.org/schemas/power/supply/oneplus,caihong-battmgr.yaml#
$schema: http://devicetree.org/meta-schemas/core.yaml#

title: OnePlus Caihong PMIC GLINK battery policy properties

maintainers:
  - Osilvfe <64585305+Osilvfe@users.noreply.github.com>

description:
  Private battery-management firmware capabilities used by the OnePlus
  Caihong development platform. The properties are referenced by the generic
  Qualcomm PMIC GLINK binding because they live on that firmware-interface
  node, while their device policy remains defined here.

select: false

$defs:
  pps-read-buffer:
    type: boolean
    description:
      The firmware implements the OnePlus read-only PPS capability-buffer
      request used to retrieve the connected source PDO table.

  pps-fixed-5v:
    type: boolean
    description:
      The firmware implements the OnePlus fixed-PDO request used to return a
      connected USB PD source to 5 V. It requires PPS capability reads.

  pps-5v5-1a:
    type: boolean
    description:
      Enable the bounded 5.5 V at 1 A programmable-PDO development test. It
      requires the fixed-5-V fallback interface.

  pps-ramp-9v-1a:
    type: boolean
    description:
      Enable the source-only 5.5-V to 9-V ramp in 0.5-V steps at 1 A. It does
      not enable a charge pump.

  pps-ramp-9v2-1a:
    type: boolean
    description:
      Extend the validated 9-V ramp with 9.1-V and 9.2-V requests at 1 A.

  pps-ramp-2to1-1a:
    type: boolean
    description:
      Enable the gauge-derived source ramp used for bounded 2-to-1 charge-pump
      development tests. This gate alone never enables a charge pump.

  pps-run-2to1-5m:
    type: boolean
    description:
      Enable the bounded end-to-end primary charge-pump development run with
      direct handoff and fixed-5-V cleanup.

  pps-policy-2to1-1a:
    type: boolean
    description:
      Enable the asynchronous single-primary 2-to-1 development policy with
      USB, battery-voltage, battery-temperature and pump-local safety checks.

  pps-policy-auto-start:
    type: boolean
    description:
      Arm the single-primary policy on physical detach and start it once on a
      subsequent confirmed source attachment.

  pps-secondary-500ms:
    type: boolean
    description:
      Enable the independently bounded secondary charge-pump test gate.

  pps-dual-500ms:
    type: boolean
    description:
      Enable the staged dual-pump development policy, including bounded boost,
      continuous monitoring and fixed-5-V cleanup.

additionalProperties: true
...
```

## Documentation/devicetree/bindings/power/supply/southchip,sc8547.yaml
```yaml
# SPDX-License-Identifier: (GPL-2.0-only OR BSD-2-Clause)
# Copyright (c) 2026 Osilvfe <osilvfe@gmail.com>
%YAML 1.2
---
$id: http://devicetree.org/schemas/power/supply/southchip,sc8547.yaml#
$schema: http://devicetree.org/meta-schemas/core.yaml#

title: Southchip SC8547 and SC8547A charge pumps

maintainers:
  - Osilvfe <osilvfe@gmail.com>

properties:
  compatible:
    enum:
      - southchip,sc8547
      - southchip,sc8547a

  reg:
    maxItems: 1

  southchip,role:
    enum: [ primary, secondary ]
    description: Charge-pump role in a paired installation.

required:
  - compatible
  - reg
  - southchip,role

additionalProperties: false

examples:
  - |
    i2c {
        #address-cells = <1>;
        #size-cells = <0>;

        charger@6f {
            compatible = "southchip,sc8547a";
            reg = <0x6f>;
            southchip,role = "primary";
        };
    };
...
```

## Documentation/devicetree/bindings/remoteproc/qcom,sm8650-camera-icp.yaml
```yaml
# SPDX-License-Identifier: (GPL-2.0-only OR BSD-2-Clause)
# Copyright (c) 2026 Osilvfe <osilvfe@gmail.com>
%YAML 1.2
---
$id: http://devicetree.org/schemas/remoteproc/qcom,sm8650-camera-icp.yaml#
$schema: http://devicetree.org/meta-schemas/core.yaml#

title: Qualcomm SM8650 Camera Image Control Processor

maintainers:
  - Osilvfe <osilvfe@gmail.com>

description:
  The Camera Image Control Processor (ICP) schedules image processing jobs on
  the Qualcomm BPS and IPE hardware blocks. Its firmware is authenticated and
  started through the Qualcomm Peripheral Authentication Service.

properties:
  compatible:
    const: qcom,sm8650-camera-icp

  reg:
    items:
      - description: ICP control and status registers
      - description: ICP watchdog registers

  reg-names:
    items:
      - const: csr
      - const: watchdog

  interrupts:
    maxItems: 1

  interrupt-names:
    const: watchdog

  clocks:
    items:
      - description: ICP AHB clock
      - description: ICP source clock
      - description: ICP core clock
      - description: Camera debug XO clock

  clock-names:
    items:
      - const: icp_ahb
      - const: icp_src
      - const: icp
      - const: qdss

  interconnects:
    maxItems: 2

  interconnect-names:
    items:
      - const: ahb
      - const: memory

  iommus:
    minItems: 5
    maxItems: 5

  dma-coherent: true

  power-domains:
    maxItems: 1

  memory-region:
    items:
      - description: Reserved memory used to load the authenticated firmware
      - description: Reserved QDSS IOVA range
      - description: Reserved device-register IOVA range
      - description: Reserved firmware-uncached IOVA range
      - description: Global synchronization memory
      - description: Reserved shared buffer IOVA range

  memory-region-names:
    items:
      - const: firmware
      - const: qdss-iova
      - const: device-iova
      - const: uncached-iova
      - const: global-sync
      - const: shared-iova

  firmware-name:
    maxItems: 1
    description: Name of the MDT firmware metadata file

required:
  - compatible
  - reg
  - reg-names
  - interrupts
  - interrupt-names
  - clocks
  - clock-names
  - interconnects
  - interconnect-names
  - iommus
  - power-domains
  - memory-region
  - memory-region-names

additionalProperties: false

examples:
  - |
    #include <dt-bindings/clock/qcom,sm8650-camcc.h>
    #include <dt-bindings/interrupt-controller/arm-gic.h>

    remoteproc@ac01000 {
        compatible = "qcom,sm8650-camera-icp";
        reg = <0x0ac01000 0x1000>, <0x0ac04000 0x1000>;
        reg-names = "csr", "watchdog";
        interrupts = <GIC_SPI 463 IRQ_TYPE_EDGE_RISING>;
        interrupt-names = "watchdog";
        clocks = <&camcc CAM_CC_ICP_AHB_CLK>,
                 <&camcc CAM_CC_ICP_CLK_SRC>,
                 <&camcc CAM_CC_ICP_CLK>,
                 <&camcc CAM_CC_QDSS_DEBUG_XO_CLK>;
        clock-names = "icp_ahb", "icp_src", "icp", "qdss";
        interconnects = <&gem_noc 0 0 &config_noc 0 0>,
                        <&mmss_noc 1 0 &mc_virt 1 0>;
        interconnect-names = "ahb", "memory";
        iommus = <&apps_smmu 0x1820 0>,
                 <&apps_smmu 0x18c0 0>,
                 <&apps_smmu 0x1800 0>,
                 <&apps_smmu 0x1840 0>,
                 <&apps_smmu 0x1880 0>;
        power-domains = <&camcc CAM_CC_TITAN_TOP_GDSC>;
        memory-region = <&camera_mem>, <&camera_icp_qdss_iova>,
                        <&camera_icp_device_iova>,
                        <&camera_icp_uncached_iova>,
                        <&global_sync_mem>,
                        <&camera_icp_shared_iova>;
        memory-region-names = "firmware", "qdss-iova", "device-iova",
                              "uncached-iova", "global-sync",
                              "shared-iova";
        firmware-name = "qcom/sm8650/CAMERA_ICP.mbn";
        dma-coherent;
    };
...
```

## drivers/media/platform/qcom/camera-icp/Kconfig
```kconfig
# SPDX-License-Identifier: GPL-2.0-only

config VIDEO_QCOM_CAMERA_ICP
	tristate "Qualcomm Camera ICP BPS V4L2 driver"
	depends on VIDEO_DEV
	depends on QCOM_CAMERA_ICP
	select V4L2_MEM2MEM_DEV
	select VIDEOBUF2_DMA_SG
	help
	  Expose the Qualcomm Camera ICP Bayer Processing System as a V4L2
	  memory-to-memory image processor.

config VIDEO_QCOM_CAMERA_NATIVE
	tristate "Caihong native V4L2 camera capture (experimental)"
	depends on VIDEO_DEV && VIDEO_QCOM_CAMSS && QCOM_CAMERA_ICP
	select VIDEOBUF2_DMA_SG
	help
	  Connect Caihong sensors through CAMSS and Camera ICP BPS to ordinary
	  NV12 capture nodes. This experimental driver shares the hardware with
	  libcamera and requires exclusive access to each sensor pipeline.
```
